## .yocto/build/conf/bblayers.conf
```bitbake
# POKY_BBLAYERS_CONF_VERSION is increased each time build/conf/bblayers.conf
# changes incompatibly
POKY_BBLAYERS_CONF_VERSION = "2"

BBPATH = "${TOPDIR}"
BBFILES ?= ""

BBLAYERS ?= " \
  /poky/meta \
  /poky/meta-poky \
  /poky/meta-yocto-bsp \
  /poky/meta-raspberrypi \
  /poky/meta-openembedded/meta-networking \
  /poky/meta-openembedded/meta-oe \
  /poky/meta-openembedded/meta-python \
  /poky/meta-image-config \
  /poky/meta-qt5 \
  /poky/meta-custom \
  /poky/meta-openembedded/meta-multimedia \
  /poky/meta-openembedded/meta-gnome \
  /poky/meta-openembedded/meta-xfce \
  /poky/meta-aws \
  "
```

## .yocto/custom-images/conf/layer.conf
```bitbake
# We have a conf and classes directory, add to BBPATH
BBPATH .= ":${LAYERDIR}"

# We have recipes-* directories, add to BBFILES
BBFILES += "${LAYERDIR}/recipes-*/*/*.bb \
            ${LAYERDIR}/recipes-*/*/*.bbappend"

BBFILE_COLLECTIONS += "custom-images"
BBFILE_PATTERN_custom-images = "^${LAYERDIR}/"
BBFILE_PRIORITY_custom-images = "6"

LAYERDEPENDS_custom-images = "core"
LAYERSERIES_COMPAT_custom-images = "kirkstone"
```

## .yocto/meta-image-config/conf/layer.conf
```bitbake
# We have a conf and classes directory, add to BBPATH
BBPATH .= ":${LAYERDIR}"

# We have recipes-* directories, add to BBFILES
BBFILES += "${LAYERDIR}/recipes-*/*/*.bb \
            ${LAYERDIR}/recipes-*/*/*.bbappend"

BBFILE_COLLECTIONS += "meta-image-config"
BBFILE_PATTERN_meta-image-config = "^${LAYERDIR}/"
BBFILE_PRIORITY_meta-image-config = "6"

LAYERDEPENDS_meta-image-config = "core"
LAYERSERIES_COMPAT_meta-image-config = "kirkstone"
```
